## boards/st/nucleo_wl33cc/Kconfig.nucleo_wl33cc
```kconfig
# Copyright (c) 2024 STMicroelectronics
# Copyright (c) 2026 Movu robotics
# SPDX-License-Identifier: Apache-2.0

config BOARD_NUCLEO_WL33CC
	select SOC_STM32WL33XX
```

## boards/st/nucleo_wl33cc/board.yml
```yaml
board:
  name: nucleo_wl33cc
  full_name: Nucleo WL3CC
  vendor: st
  socs:
    - name: stm32wl33
```

## drivers/interrupt_controller/Kconfig.stm32
```kconfig
# STM32 EXTI configuration

# Copyright (c) 2016 Open-RnD Sp. z o.o.
# Copyright (c) 2025 Alexander Kozhinov <ak.alexander.kozhinov@gmail.com>
# Copyright (c) 2026 Movu robotics
# SPDX-License-Identifier: Apache-2.0

if SOC_FAMILY_STM32

config EXTI_STM32
	bool "STM32 External Interrupt/Event Controller (EXTI) Driver"
	default y
	depends on DT_HAS_ST_STM32_EXTI_ENABLED
	help
	  Enable STM32 EXTI driver

config GPIO_INTC_STM32
	bool "STM32 GPIO Interrupt/Event Controller (EXTI) Driver"
	default y
	depends on EXTI_STM32
	help
	  Enable STM32 GPIO interrupt controller driver

config GPIO_INTC_STM32WB0
	bool "GPIO Interrupt Controller Driver for STM32WB0 series"
	default y
	depends on DT_HAS_ST_STM32WB0_GPIO_INTC_ENABLED
	help
	  Enable GPIO interrupt controller driver for STM32WB0 series

config GPIO_INTC_STM32WL3
	bool "GPIO Interrupt Controller Driver for STM32WL3 series"
	default y
	depends on DT_HAS_ST_STM32WL3_GPIO_INTC_ENABLED
	help
	  Enable GPIO interrupt controller driver for STM32WL3 series

endif # SOC_FAMILY_STM32
```

## drivers/mrsubg/Kconfig
```kconfig
config MRSUBG_STM32WL3
	bool "STM32WL3 SubGhz driver"
	default y
	depends on DT_HAS_ST_MRSUBG_ENABLED
	select HAS_STM32LIB
	select USE_STM32_HAL_PKA
	select USE_STM32_HAL_CORTEX
	select USE_STM32_HAL_GPIO
	select USE_STM32_HAL_RADIO
	select USE_STM32_HAL_RADIO_TIMER
	help
	  ST STM32WL3 SubGhz Radio interface
```

## drivers/timer/Kconfig.stm32wl3_radio_timer
```kconfig
# STM32WL3X radio timer configuration options

# Copyright (c) 2025 STMicroelectronics
# Copyright (c) 2026 Movu robotics
# SPDX-License-Identifier: Apache-2.0

config STM32WL3_RADIO_TIMER
	bool "STM32 Radio Timer for WL3x"
	default y if PM
	depends on SOC_SERIES_STM32WL3X
	select HAS_STM32LIB
	select TICKLESS_CAPABLE
	select SYSTEM_TIMER_HAS_DISABLE_SUPPORT
```

## dts/bindings/clock/st,stm32wl3-lsi-clock.yaml
```yaml
# Copyright (c) 2024 STMicroelectronics
# Copyright (c) 2026 Movu robotics
# SPDX-License-Identifier: Apache-2.0

description: |
  STM32WL3 LSI Clock

  The STM32WL3 MCUs are equipped with a regular RC LSI clock with a frequency of 24~40kHz.
  The SoCs are also equipped with hardware to perform LSI frequency measurement, which
  allows to adapt all frequency-based calculations to a somewhat accurate value, ensuring
  that the software does not get too much out of sync with real-world time.

  Several LSI frequency measurement options can be configured via Kconfig.

compatible: "st,stm32wl3-lsi-clock"

include: [fixed-clock.yaml]
```

## dts/bindings/flash_controller/st,stm32wl3-flash-controller.yaml
```yaml
# Copyright (c) 2024 STMicroelectronics
# Copyright (c) 2026 Movu robotics
# SPDX-License-Identifier: Apache-2.0

description: STM32WL3 series flash controller

compatible: "st,stm32wl3-flash-controller"

include: flash-controller.yaml
```

## dts/bindings/interrupt-controller/st,stm32wl3-gpio-intc.yaml
```yaml
# Copyright (c) 2024 STMicroelectronics
# Copyright (c) 2026 Movu robotics
# SPDX-License-Identifier: Apache-2.0

description: STM32WL3 GPIO Interrupt Controller

compatible: "st,stm32wl3-gpio-intc"

include: "st,stm32-exti.yaml"
```

## dts/bindings/mrsubg/st,mrsubg.yaml
```yaml
description: STM32WL3 MR_SUBG radio subsystem driver template

compatible: "st,mrsubg"

include: base.yaml
```

## soc/st/stm32/stm32wl3x/Kconfig
```kconfig
# STMicroelectronics STM32WL3 MCU series

# Copyright (c) 2024 STMicroelectronics
# Copyright (c) 2026 Movu robotics
# SPDX-License-Identifier: Apache-2.0

config SOC_SERIES_STM32WL3X
	select ARM
	select CPU_CORTEX_M0PLUS
	select CPU_CORTEX_M_HAS_VTOR
	select CPU_CORTEX_M_HAS_SYSTICK
	select CPU_HAS_ARM_MPU
	select USE_STM32_HAL_PWR
	select USE_STM32_HAL_PWR_EX
	select HAS_PM
	select HAS_STM32CUBE
	select SOC_EARLY_INIT_HOOK
	select PM_DEVICE if PM
	select HAS_PM_S2RAM_CUSTOM_MARKING
```

## soc/st/stm32/stm32wl3x/Kconfig.defconfig
```kconfig
# STMicroelectronics STM32WL3 MCU line

# Copyright (c) 2024 STMicroelectronics
# Copyright (c) 2026 Movu robotics
# SPDX-License-Identifier: Apache-2.0

if SOC_SERIES_STM32WL3X

config NUM_IRQS
	default 32

if STM32WL3_RADIO_TIMER

config SYS_CLOCK_TICKS_PER_SEC
	default 32768

config CORTEX_M_SYSTICK
	default n

DT_STM32WL3_RADIO_TIMER_PATH := $(dt_nodelabel_path,radio_timer)
DT_STM32WL3_TIMER_FREQ := $(dt_node_int_prop_int,$(DT_STM32WL3_RADIO_TIMER_PATH),compensated-timer-freq)

config SYS_CLOCK_HW_CYCLES_PER_SEC
	default "$(DT_STM32WL3_TIMER_FREQ)"

endif # STM32WL3_RADIO_TIMER

endif # SOC_SERIES_STM32WL3X
```
